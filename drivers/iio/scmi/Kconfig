## drivers/iio/scmi/Kconfig
```kconfig
#
# IIO over SCMI
#
# When adding new entries keep the list in alphabetical order

menu "IIO SCMI Sensors"

config IIO_SCMI
	tristate "IIO SCMI"
	help
	  Say yes here to build support for IIO SCMI Driver. This driver provides
	  support for accelerometer and gyroscope sensors available on SCMI based platforms.

config IIO_SCMI_STUB
	tristate "IIO over SCMI sensor stub"
	help
	  Say yes here to build support for the stub ARM Sensor protocol SCMI device

endmenu
```

## sound/virtio/Kconfig
```kconfig
# SPDX-License-Identifier: GPL-2.0+
# Sound card driver for virtio

config SND_VIRTIO
	tristate "Virtio sound driver"
	depends on VIRTIO
	select SND_PCM
	select SND_JACK
	help
          This is the virtual sound driver for virtio.  It can be used with
          QEMU based VMMs (like KVM or Xen).  Say Y or M.
```
